## conf/distro/poky-systemd.conf
```bitbake
include poky.conf

DISTRO-NAME= "poky-systemd"
DISTRO_VERSION= "1.0"

DISTRO_FEATURES:append = " systemd"
DISTRO_FEATURES_BACKFILL_CONSIDERED = "sysvinit"
VIRTUAL-RUNTIME_init_manager = "systemd"
VIRTUAL-RUNTIME_initscripts = ""

PACKAGE_CLASSES = "package_rpm"

EXTRA_IMAGE_FEATURES += " debug-tweaks ssh-server-dropbear package-management"

#IMAGE_INSTALL:append = " openssh"
```
